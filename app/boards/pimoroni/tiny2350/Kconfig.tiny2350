## app/boards/pimoroni/tiny2350/Kconfig.tiny2350
```kconfig
# Copyright (c) 2024 Andrew Featherstone
# Copyright (c) 2025 Magpie Embedded
# SPDX-License-Identifier: Apache-2.0

config BOARD_TINY2350
	select SOC_RP2350A_M33
```

## app/boards/pimoroni/tiny2350/board.yml
```yaml
board:
  name: tiny2350
  full_name: Tiny 2350
  vendor: pimoroni
  socs:
  - name: rp2350a
```

## app/modules/drivers/custom_led/Kconfig
```kconfig
config CUSTOM_LED
	bool "Custom LED driver"
	depends on GPIO && SENSOR

config CUSTOM_LED_SHELL
	bool "Custom LED shell commands"
	depends on CUSTOM_LED && SHELL
	help
	  The `sensor` shell command: fetch, read, info and set.
```

## app/modules/dts/bindings/driver/custom_led.yaml
```yaml
description: Custom LED sensor

compatible: "course,custom-led"

include: base.yaml

properties:
  gpios:
    type: phandle-array
    required: true
```
